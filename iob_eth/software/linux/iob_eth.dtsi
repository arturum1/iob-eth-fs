// SPDX-FileCopyrightText: 2025 IObundle
//
// SPDX-License-Identifier: MIT

/* Auto-generated device tree include file (.dtsi) for iob_eth peripheral core.
 * Include this file in your main SoC device tree.
 */

&soc {
    // Include this core as a peripheral of main system labeled 'soc'.
    INSTANCE_NAME: iob_eth@/*INSTANCE_NAME_BASE_MACRO*/ {
        compatible = "iobundle,eth0";
        reg = <0x/*INSTANCE_NAME_BASE_MACRO*/ 0x/*IOB_ETH_CSRS_ADDR_RANGE_MACRO*/>;
        
    };
};